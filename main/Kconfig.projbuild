## main/Kconfig.projbuild
```kconfig
menu "Custom Config"
    config ESP_DPP_LISTEN_CHANNEL_LIST
        string "DPP Listen channel list"
        default "6"
        help
            DPP Bootstrapping listen channels separated by commas.

    config ESP_DPP_BOOTSTRAPPING_KEY
        string "Bootstrapping key"
        help
            64 hex digits (or 32 bytes) of raw private key for DPP Bootstrapping.

    config ESP_DPP_DEVICE_INFO
        string "Additional Device Info"
        help
            Additional ancillary information to be included in QR Code.
    
    choice ESP_WIFI_SAE_MODE
        prompt "WPA3 SAE mode selection"
        default ESP_STATION_EXAMPLE_WPA3_SAE_PWE_BOTH
        help
            Select mode for SAE as Hunt and Peck, H2E or both.
        config ESP_STATION_EXAMPLE_WPA3_SAE_PWE_HUNT_AND_PECK
            bool "HUNT AND PECK"
        config ESP_STATION_EXAMPLE_WPA3_SAE_PWE_HASH_TO_ELEMENT
            bool "H2E"
            depends on ESP_WIFI_ENABLE_SAE_H2E
        config ESP_STATION_EXAMPLE_WPA3_SAE_PWE_BOTH
            bool "BOTH"
            depends on ESP_WIFI_ENABLE_SAE_H2E
    endchoice

    config ESP_WIFI_PW_ID
        string "PASSWORD IDENTIFIER"
        depends on  ESP_STATION_EXAMPLE_WPA3_SAE_PWE_HASH_TO_ELEMENT|| ESP_STATION_EXAMPLE_WPA3_SAE_PWE_BOTH
        default ""
        help
            password identifier for SAE H2E

    config ESP_MAXIMUM_RETRY
        int "Maximum retry"
        default 5
        help
            Set the Maximum retry to avoid station reconnecting to the AP unlimited when the AP is really inexistent.

    choice ESP_WIFI_SCAN_AUTH_MODE_THRESHOLD
        prompt "WiFi Scan auth mode threshold"
        default ESP_WIFI_AUTH_WPA2_PSK
        help
            The weakest authmode to accept in the scan mode.
            This value defaults to ESP_WIFI_AUTH_WPA2_PSK in case password is present and ESP_WIFI_AUTH_OPEN is used.
            Please select ESP_WIFI_AUTH_WEP/ESP_WIFI_AUTH_WPA_PSK in case AP is operating in WEP/WPA mode.

        config ESP_WIFI_AUTH_OPEN
            bool "OPEN"
        config ESP_WIFI_AUTH_WEP
            bool "WEP"
        config ESP_WIFI_AUTH_WPA_PSK
            bool "WPA PSK"
        config ESP_WIFI_AUTH_WPA2_PSK
            bool "WPA2 PSK"
        config ESP_WIFI_AUTH_WPA_WPA2_PSK
            bool "WPA/WPA2 PSK"
        config ESP_WIFI_AUTH_WPA3_PSK
            bool "WPA3 PSK"
        config ESP_WIFI_AUTH_WPA2_WPA3_PSK
            bool "WPA2/WPA3 PSK"
        config ESP_WIFI_AUTH_WAPI_PSK
            bool "WAPI PSK"
    endchoice

    config OTA_UPDATES_INTERVAL
        string "Ota updates interval (h)"
        help
            How often ESP will hit HTTPS server, looking for newer software. 6 is default
endmenu
```
